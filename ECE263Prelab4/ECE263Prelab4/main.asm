;
; ECE263Lab4.asm
;
; Created: 2/14/2022 4:15:56 AM
; Author : Artem Dudko and Nikolas Tapanainen
;
.include "m328pbdef.inc"
.list
.org 0x0000

CALL IPRINT ; INITIALIZE USART



;ROUTINES:

	;RESET - SETUP EVERYTHING, CLEAR REGISTERS AFTER PREVIOUS PRESSES
	;MAINLOOP - RUNS WHILE NOTHING IS PRESSED, CHECKS FOR INPUT

	;MAINLOOP > PAUSE - ONCE INPUT IS DETECTED, SAVE INPUT PATTERN TO R19
	;PAUSE > INPUT2VAL - CONVERT INPUT PATTERN TO A VALUE 0-F, CORRESPONDING WITH THE LOCATION OF THE BUTTON PRESS ON THE KEYPAD
		;THIS IS CONVENITENT FOR COUNTING AND SIMPLIFYING CODE

		;KEYPAD PRESS:
		;0 1 2 3
		;4 5 6 7
		;8 9 A B
		;C D * #

		;||||||||
		;VVVVVVVV

		;VAL OUTPUT
		;0 1 2 3
		;4 5 6 7
		;8 9 A B
		;C D * #

	;INPUT2VAL > DISPLAY_ASCII - FINDS ASCII CODE CORRESPONDING TO VAL AND PRINTS IT IN PUTTY
	;DISPLAY_ASCII > DISPLAY_VAL2SS - ONCE ASCII IS SENT, SEND PATTERN TO TURN ON SEVEN SEGMENT ACCORDING TO VAL
	;DISPLAY_VAL2SS > RESUMEINPUT - LOOPS WHILE SOME BUTTON IS PRESSED TO PREVENT DOUBLE INPUTS
	;RESUMEINPUT > RESET - ONCE NOTHING IS PRESSED, RUN THE SETUP FOR THE NEXT PRESS



;PROGRAM SETUP
;PART 0
		LDI 	R16, 0xFF		;SET C TO OUTPUT AND ALL 1'S. LIKE TRAFFIC LIGHT, A 1 OUTPUT MEANS THE LIGHT WILL BE OFF
		LDI		R17, 0x0

		OUT		DDRB, R16		;SET B TO OUTPUT
		OUT		PORTB, R16
		OUT		DDRC, R16		;SET C TO OUTPUT
		OUT		PORTC, R16
		OUT		DDRD, R17		;SET D TO PULL UP INPUT MODE
		OUT		PORTD, R16

		SBI		DDRB, 5			;SET = 1, CLEAR = 0. THIS SETS BIT IN DDRB TO 1
		SBI		PORTB, 5		;SET BIT 5 IN PORTB TO 1
		SBI		DDRD, 1			;LEAVE PD1 FREE TO TRANSMIT

		
;PART1
RESET:
		LDI R18,0xFF	;RESET REGISTERS FROM CALCS
		LDI R19,0
		LDI R20,0

		OUT	PORTC, R18	;CLEAR SEVEN SEG
		OUT PORTD, R18
		SBI	PORTB, 5

		CALL BOUNCEDELAY	;ACCOUNT FOR RELEASE BOUNCE
		

;PART 2
MAINLOOP:						;MAINLOOP AND CHECKINPUT MONITORS THE FOUR D PINS BY CYCLING THE B INPUT

		SBI		PORTB, 0
		CBI		PORTB, 3
		NOP
		IN		R18, PIND
		ANDI	R18, 0xF0
		CPI		R18, 0xF0
		BRNE	PAUSE
		
		SBI		PORTB, 3
		CBI		PORTB, 2
		NOP
		IN		R18, PIND
		ANDI	R18, 0xF0
		CPI		R18, 0xF0
		BRNE	PAUSE
		
		SBI		PORTB, 2
		CBI		PORTB, 1
		NOP
		IN		R18, PIND
		ANDI	R18, 0xF0
		CPI		R18, 0xF0
		BRNE	PAUSE
		
		SBI		PORTB, 1
		CBI		PORTB, 0
		NOP
		IN		R18, PIND
		ANDI	R18, 0xF0
		CPI		R18, 0xF0
		BRNE	PAUSE

RJMP MAINLOOP

;PART 3					;TAKE IN PIND AND PORTB, OUTPUT R19 AS THE INPUTPATTERN
PAUSE:					
		CALL	BOUNCEDELAY		;ACCOUNT FOR SWITCH BOUNCE
		IN		R19, PIND		;ONCE INPUT ON PORTD IS DETECTED, COMBINE RELEVANT B AND AND D PINS INTO ONE R19
		ANDI	R19, 0b11110000
		IN		R20, PORTB
		ANDI	R20, 0b00001111
		ADD		R19, R20
RJMP	INPUT2VAL

;PART 4
INPUT2VAL:					;TAKE IN R19, OUTPUT R20
		LDI		R20, 0x0				 
		LDI		ZH,HIGH(INPUTPAT<<1)
		LDI		ZL,LOW(INPUTPAT<<1)

NEXTPAT:LPM		R17, Z
		CP		R19, R17
		BREQ	DISPLAY_ASCII
		INC		R30
		INC		R20
RJMP NEXTPAT

;PART 5
DISPLAY_ASCII:		;R20 HAS THE NUMBER VALUE, PRINT IT IN R16
		;CALL VAL2ASCII			;TAKES A VALUE 0-F AND RETURNS AN ASCII CODE IN R20
		LDI		ZH,HIGH(ASCIISYMBOLS<<1)
		LDI		ZL,LOW(ASCIISYMBOLS<<1)
									;Z POINTS TO PATTERN FOR ZERO
									;ADD R20 TO Z, AND THEN LPM PATTERN
		CLR		R21
		ADD		ZL,R20
		ADC		ZH,R21			;ADD WITH CARRY FROM THE LOWER REGISTER
		LPM		R16,Z			;LOAD PATTERN INTO R21

		CALL PRINT
RJMP DISPLAY_VAL2SS

;PART 6						;OUTPUT R20 VALUE TO SEVEN SEGMENT
DISPLAY_VAL2SS:				
		CALL VAL2SS			;TAKES A VALUE 0-F FROM R20 AND RETURNS A PATTERN IN R21
		COM R21					;SWAP 1 AND 0
		OUT PORTC, R21			;OUTPUTS FEDCBA, NOT G. THIS IS WHERE YOU HAVE TO BE CAREFUL, AS G IS ALSO THE 
											;PORTB RESPONSIBLE FOR YOUR KEYBOARD. NEED TO GET CUTE WITH BIT INSTRUCTIONS.
												;FOUR INSTRUCTIONS OF INTEREST: SBIC Rr,B, SBIS Rr,b,
		SBRS	R21, 6			;SKIP IF g BIT SET
		RJMP	DSP1
		SBI		PORTB,5			;SOMETHING (IF R21, BIT 6 = 1)
		RJMP	DSP2
DSP1:	CBI		PORTB,5			;SOMETHING (IF R21, BIT 6 = 0)
DSP2:	RJMP RESUMEINPUT						;SOMETHING
		
;PART 7			;INPUT R20 AS THE VALUE, OUTPUT R21 AS THE SEVEN SEGEMENT PATTERN
VAL2SS:
			LDI		ZH,HIGH(SSPATTERN<<1)
			LDI		ZL,LOW(SSPATTERN<<1)
									;Z POINTS TO PATTERN FOR ZERO
									;ADD R20 TO Z, AND THEN LPM PATTERN
			CLR		R21
			ADD		ZL,R20
			ADC		ZH,R21			;ADD WITH CARRY FROM THE LOWER REGISTER
			LPM		R21,Z			;LOAD PATTERN INTO R21
	RET

;PART 8
RESUMEINPUT:
		IN		R18, PIND
		ANDI	R18, 0xF0
		CPI		R18, 0xF0
		BRNE	RESUMEINPUT
RJMP	RESET









BOUNCEDELAY:	LDI	R23,200
	DELAY1:			LDI	R24,40	  
	DELAY2:			DEC	R24  
					BRNE	DELAY2	 
					DEC	R23		  
					BRNE	DELAY1
					NOP		
	RET
	
;SEVEN SEG PATTERNS CORRESPONDING WITH VAL
.ORG	0x600		
SSPATTERN:	 ;XGFEDCBA	  XGFEDCBA    XGFEDCBA 	  XGFEDCBA
		.DB 0b00000110,	0b01011011,	0b01001111,	0b01110111  ;0 1 2 3
		.DB 0b01100110,	0b01101101,	0b01111101,	0b01111100	;4 5 6 7
		.DB 0b00000111,	0b01111111,	0b01101111,	0b00111001	;8 9 A B
		.DB 0b00000000,	0b00111111,	0b00000000,	0b01011110	;C D * #

;ASCII CODE CORRESPONDING WITH VAL
.ORG	0x0700
ASCIISYMBOLS:
		.DB "123A"	;1 2 3 A
		.DB "456B"	;4 5 6 B
		.DB "789C"	;7 8 9 C
		.DB "*0#D"	;* 0 # D

;HEX VALUE CORRESPONDING WITH THE INPUT PATTERN
.ORG	0x0720
INPUTPAT:
		.DB 0b01110111,	0b10110111,	0b11010111,	0b11100111  ;0 1 2 3
		.DB 0b01111011,	0b10111011,	0b11011011,	0b11101011	;4 5 6 7
		.DB 0b01111101,	0b10111101,	0b11011101,	0b11101101	;8 9 A B
		.DB 0b01111110,	0b10111110,	0b11011110,	0b11101110	;C D * #




; Replace with your application code
; ECE 263 CODE FOR LAB 4 TO PRINT TO TERMINAL
;USAGE:
; ONE TIME BEFORE ANY PRINTING:
; CALL IPRINT ; AS IN INITIALIZE PRINTING
;
; TO PRINT ASCI CHAR IN R16
; CALL PRINT
.equ PRINT = 0x0500
.equ IPRINT = 0x0509
.org 0x0500
.dw 0x934f, 0x9140, 0x00c0, 0xff45, 0xcffc, 0x9300, 0x00c6, 0x914f
.dw 0x9508, 0x93ff, 0xe0f0, 0x93f0, 0x00c0, 0xe0f8, 0x93f0, 0x00c1
.dw 0xe0f6, 0x93f0, 0x00c2, 0xe0f0, 0x93f0, 0x00c5, 0xe6f7, 0x93f0
.dw 0x00c4, 0x91ff, 0x9508, 0x5048, 0x494c, 0x2056, 0x4841, 0x4c4c 







;ARCHIVED CODE, JUST IN CASE:

/*
INPUT2VAL:					;TAKES INPUT REGISTER R19 AND MATCHES THE PATTERN IN IT 
		LDI R20, 0x1
		CPI R19, 0b01110111
		BREQ DISPLAY_ASCII
		LDI R20, 0x2
		CPI R19, 0b10110111
		BREQ DISPLAY_ASCII
		LDI R20, 0x3
		CPI R19, 0b11010111
		BREQ DISPLAY_ASCII
		LDI R20, 0xA
		CPI R19, 0b11100111
		BREQ DISPLAY_ASCII

		LDI R20, 0x4
		CPI R19, 0b01111011
		BREQ DISPLAY_ASCII
		LDI R20, 0x5
		CPI R19, 0b10111011
		BREQ DISPLAY_ASCII
		LDI R20, 0x6
		CPI R19, 0b11011011
		BREQ DISPLAY_ASCII
		LDI R20, 0xB
		CPI R19, 0b11101011
		BREQ DISPLAY_ASCII

		LDI R20, 0x7
		CPI R19, 0b01111101
		BREQ DISPLAY_ASCII
		LDI R20, 0x8
		CPI R19, 0b10111101
		BREQ DISPLAY_ASCII
		LDI R20, 0x9
		CPI R19, 0b11011101
		BREQ DISPLAY_ASCII
		LDI R20, 0xC
		CPI R19, 0b11101101
		BREQ DISPLAY_ASCII

		LDI R20, 0xE ;* = E IN MEMORY
		CPI R19, 0b01111110
		BREQ DISPLAY_ASCII
		LDI R20, 0x0
		CPI R19, 0b10111110 ;0xBE
		BREQ DISPLAY_ASCII
		LDI R20, 0xF  ;# = F IN MEMORY
		CPI R19, 0b11011110
		BREQ DISPLAY_ASCII
		LDI R20, 0xD
		CPI R19, 0b11101110
		BREQ DISPLAY_ASCII

RJMP	START
*/

/* OLD
INPUTPAT:
		.DB 0b10110111,	0b11010111,	0b11100111, 0b11011101	;1 2 3 A
		.DB 0b01111011,	0b10111011,	0b11011011,	0b11101101	;4 5 6 B
		.DB 0b11101011, 0b01111101,	0b10111101,	0b01111110	;7 8 9 C
		.DB 0b11011110,	0b01110111,	0b11101110,	0b10111110	;* 0 # D
*/



/*
ASCIISYMBOLS:
		.DB 0b00110000,	0b00110001,	0b00110010,	0b00110011  ;0 1 2 3
		.DB 0b00110100,	0b00110101,	0b00110110,	0b00110111	;4 5 6 7
		.DB 0b00111000,	0b00111001,	0b01000001,	0b01000010	;8 9 A B
		.DB 0b01000011,	0b01000100,	0b00101010,	0b00100011	;C D * #


*/


		/*
.ORG	0x800
ASCIIREF2:
		.DB '0123', ;0 1 2 3
		.DB '4567',	;4 5 6 7
		.DB '89AB',	;8 9 A B
		.DB 'CD*#',	;C D * #*/


		/*
.ORG	0x0700
ASCIISYMBOLS:
		.DB 0b00110001,	0b00110010,	0b00110011, 0b01000001	;1 2 3 A
		.DB 0b00110100,	0b00110101,	0b00110110,	0b01000010	;4 5 6 B
		.DB 0b00110111, 0b00111000,	0b00111001,	0b01000011	;7 8 9 C
		.DB 0b00101010,	0b00110000,	0b00100011,	0b01000100	;* 0 # D
		*/